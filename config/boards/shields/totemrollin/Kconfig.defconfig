## config/boards/shields/totemrollin/Kconfig.defconfig
```kconfig
# Copyright (c) 2022 The ZMK Contributors
# SPDX-License-Identifier: MIT

if SHIELD_TOTEMROLLIN_LEFT

config ZMK_KEYBOARD_NAME
    default "TOTEMROLLIN"
    
config ZMK_SPLIT_ROLE_CENTRAL
    default y

endif

if SHIELD_TOTEMROLLIN_LEFT || SHIELD_TOTEMROLLIN_RIGHT

config ZMK_SPLIT
    default y

endif
```

## config/boards/shields/totemrollin/Kconfig.shield
```kconfig
# Copyright (c) 2022 The ZMK Contributors
# SPDX-License-Identifier: MIT

config SHIELD_TOTEMROLLIN_LEFT
    def_bool $(shields_list_contains,totemrollin_left)

config SHIELD_TOTEMROLLIN_RIGHT
    def_bool $(shields_list_contains,totemrollin_right)
```
